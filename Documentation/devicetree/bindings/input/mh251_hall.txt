## Documentation/devicetree/bindings/input/mh251_hall.txt
```
mst_mh251 hall senser module

Example:

hsensor:mh251@0 {
		compatible = "marvell,hsensor";
};
```

## Documentation/devicetree/bindings/misc/data-path.txt
```
* PSD data path driver

** data-path

Required properties:
- version: supported driver version
- compatible: compatible name, must be "marvell,data-path"

Example:
data-path {
	compatible = "marvell,data-path";
	version = <1>;
};
```

## Documentation/devicetree/bindings/misc/usim.txt
```
* usim card detector

** usim

Required properties:
- compatible: "marvell,usim1" "marvell,usim2 "marvell,usimtray"
- pinctrl-names : Names corresponding to the numbered pinctrl states
- pinctrl-<n> : Pinctrl states as described in bindings/pinctrl/pinctrl-bindings.txt
- edge-wakeup-gpio: the gpio for edge wake up

Example:
usim1: usim@0 {
        compatible = "marvell,usimtray";
        pinctrl-names = "default", "sleep";
        pinctrl-0 = <&usim1_pmx_func>;
        pinctrl-1 = <&usim1_pmx_func_sleep>;
        edge-wakeup-gpio = <50>;
        status = "okay";
};
```

## Documentation/devicetree/bindings/vibrator/drv2604_vibrator.txt
```
Device tree bindings for Texas-Instruments drv2604 vibrator driver

Required properties:

 - compatible:		Should be "ti,drv2604-vibrator".
 - reg:		I2C client number (0x5a as defined in drv2604 datasheet).
 - vibrator-supply:	Regulator that supplies the vibrator driver.
 - average-voltage-mv:	The average voltage from motor spec. Needed to calculate
			the rated voltage.
 - average-overdrive-voltage-mv:
 			The average overdrive voltage. Needed to calculate the
			overdrive clamp voltage.

Optional properties:
 - trig_gpio:		Used to trigger the vibrator using GPIO instead of I2C writes.
			Note that if this property is not defined the driver
			will configure with I2C writes by default.
 - actuator-type:	Sets the actuator type (ERM or LRA). by default it is ERM.
 - bemf-gain:		Analog gain of back-EMF amplifier. By default sets to 0
			(x0.33 for ERM or x5 for LRA).
 - loop-response:	loop gain for the feedback control. By default sets to 1 (Medium).
 - brake-factor:	feedback gain ratio between braking gain and driving gain.
			By default sets to 2 (x3).
 - drive-time-usec:	ERM only, used to calculate overdrive clamp voltage.
			By default sets to 4800[usec].
 - current-dissipation-time-usec:
			ERM only, used to calculate overdrive clamp voltage.
			By default sets to 75[usec].
 - blanking-time-usec:	ERM only, used to calculate overdrive clamp voltage.
			By default sets to 75[usec].


Example:

	vibrator: vibrator@5a {
		compatible = "ti,drv2604-vibrator";
		reg = <0x5a>;
		vibrator-supply = <&ldo10>;
		rst_gpio = <&gpio 78 0>;
		actuator-type = <0>; //ERM
		average-voltage-mv = <2582>;
		average-overdrive-voltage-mv = <3600>;
	};
```
