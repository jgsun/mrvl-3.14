/*
* charger, battery parameters are based on Wasam Technology (ShenZhen) battery using 88pm88x
* Part Name: Li-ion Polymer Rechargeable Battery
* Pack Standard: 2500mAh(0.2C)
* Cell Model: LT513(4.35V)
*/
&pmic0 {
	charger {
		prechg-current = <450>;
		prechg-voltage = <3000>;
		fastchg-voltage = <4350 4350 4350>; /* LTR, STR, HTR */
		fastchg-cur = <1000 1000 1000>; /* LTR, STR, HTR */
		fastchg-eoc = <120>;
		fastchg-tout = <8>;
		recharge-thr = <100>;
		dcp-limit = <2400>;
		status = "okay";
	};

	battery {
		bat-ntc-support = <1>;
		bat-capacity = <2500>;		/* mAh */

		low-threshold = <6>;		/* % */
		high-threshold = <60>;		/* % */

		ocv-table = <
			3208 3469 3535 3600 3637 3675 3687 3688 3689 3690
			3691 3695 3699 3706 3712 3717 3722 3728 3734 3738
			3742 3745 3748 3752 3755 3759 3762 3765 3767 3770
			3773 3776 3778 3781 3783 3786 3788 3791 3793 3796
			3799 3802 3805 3809 3812 3816 3820 3824 3828 3833
			3837 3842 3846 3852 3857 3864 3870 3879 3887 3897
			3907 3918 3928 3938 3947 3955 3963 3969 3974 3980
			3986 3995 4003 4017 4031 4046 4061 4068 4075 4083
			4090 4100 4110 4120 4130 4141 4152 4163 4173 4184
			4194 4205 4216 4228 4239 4251 4262 4274 4286 4298
		>;
		power-off-th = <3350>; /* mV */
		safe-power-off-th = <3000>; /* mV */

		/* battery temerature feature parameters */

		abs-lowest-temp = <0>;
		t1-degree = <0>;	/* 0C */
		t2-degree = <10>;	/* 10C */
		t3-degree = <40>;	/* 40C */
		t4-degree = <50>;	/* 50C */

		times-in-minus-ten = <2>;
		offset-in-minus-ten = <100>;
		times-in-zero = <1>;
		offset-in-zero = <0>;

		soc-low-th-cycle = <15>;
		soc-high-th-cycle = <85>;

		zero-degree-ohm = <28267>;

		/* -24C, -23C, ..., 62C, 63C */
		ntc-table =
		<91799 24>,
		<87035 23>,
		<82552 22>,
		<78330 21>,
		<74353 20>,
		<70605 19>,
		<67072 18>,
		<63739 17>,
		<60594 16>,
		<57626 15>,
		<54822 14>,
		<52174 13>,
		<49671 12>,
		<47305 11>,
		<45067 10>,
		<42950 9>,
		<40946 8>,
		<39048 7>,
		<37251 6>,
		<35548 5>,
		<33934 4>,
		<32403 3>,
		<30952 2>,
		<29574 1>, /* negative temperature */

		<28267 0>,
		<27025 1>,
		<25846 2>,
		<24726 3>,
		<23661 4>,
		<22649 5>,
		<21686 6>,
		<20771 7>,
		<19899 8>,
		<19070 9>,
		<18280 10>,
		<17527 11>,
		<16810 12>,
		<16127 13>,
		<15476 14>,
		<14855 15>,
		<14262 16>,
		<13697 17>,
		<13157 18>,
		<12642 19>,
		<12150 20>,
		<11680 21>,
		<11231 22>,
		<10802 23>,
		<10392 24>,
		<10000 25>,
		<9624 26>,
		<9265 27>,
		<8922 28>,
		<8593 29>,
		<8278 30>,
		<7977 31>,
		<7688 32>,
		<7411 33>,
		<7146 34>,
		<6891 35>,
		<6648 36>,
		<6414 37>,
		<6189 38>,
		<5974 39>,
		<5768 40>,
		<5569 41>,
		<5379 42>,
		<5196 43>,
		<5020 44>,
		<4852 45>,
		<4689 46>,
		<4533 47>,
		<4384 48>,
		<4239 49>,
		<4101 50>,
		<3967 51>,
		<3839 52>,
		<3716 53>,
		<3597 54>,
		<3482 55>,
		<3372 56>,
		<3266 57>,
		<3163 58>,
		<3065 59>,
		<2970 60>,
		<2878 61>,
		<2790 62>,
		<2705 63>;
	};
};
